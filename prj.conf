## CMakeLists.txt
```
# SPDX-License-Identifier: Apache-2.0

cmake_minimum_required(VERSION 3.20.0)
find_package(Zephyr REQUIRED HINTS $ENV{ZEPHYR_BASE})
project(embedded_rtos_sensor_hub)

target_include_directories(app PRIVATE include)

target_sources(app PRIVATE
  src/main.c
  src/sensor_hub.c
  src/acquisition.c
  src/sim_bus.c
)
```

## Kconfig
```
mainmenu "Embedded RTOS Sensor Hub"

menu "Sensor hub"

config SENSOR_HUB_INJECT_STALL
	bool "Inject deterministic vibration-sensor stall"
	default n
	help
	  Stop the simulated vibration producer after a fixed number of samples.
	  This is used to exercise stale-sensor supervision.

config SENSOR_HUB_STALL_AFTER_SAMPLES
	int "Samples before injected vibration stall"
	default 12
	range 1 10000

config SENSOR_HUB_STALE_AFTER_MS
	int "Sensor stale timeout in milliseconds"
	default 250
	range 10 60000

config SENSOR_HUB_DRIVER_MAX_RETRIES
	int "Maximum bus retries after the first failed transfer"
	default 2
	range 0 10
	help
	  Number of retry attempts allowed after an initial acquisition failure.

config SENSOR_HUB_INJECT_BUS_FAULT
	bool "Inject deterministic vibration bus failures"
	default n
	help
	  Inject a bounded sequence of simulated bus read failures for the
	  vibration sensor to exercise retry and recovery behavior.

config SENSOR_HUB_BUS_FAULT_AFTER_SAMPLES
	int "Samples before injected bus fault"
	default 8
	range 1 10000

config SENSOR_HUB_BUS_FAULT_ATTEMPTS
	int "Consecutive simulated bus failures"
	default 2
	range 1 100

endmenu

source "Kconfig.zephyr"
```

## west.yml
```
manifest:
  remotes:
    - name: zephyrproject-rtos
      url-base: https://github.com/zephyrproject-rtos

  projects:
    - name: zephyr
      remote: zephyrproject-rtos
      revision: v4.4.2
      path: zephyr
      west-commands: scripts/west-commands.yml

  self:
    path: .
```

## prj.conf
```kconfig
CONFIG_LOG=y
CONFIG_LOG_DEFAULT_LEVEL=3
CONFIG_ASSERT=y
CONFIG_MAIN_STACK_SIZE=2048
```

## src/main.c
```c
/*
 * Copyright (c) 2026 Taha Zarif
 *
 * SPDX-License-Identifier: Apache-2.0
 */

#include <stdint.h>

#include <zephyr/kernel.h>
#include <zephyr/logging/log.h>
#include <zephyr/sys/util.h>

#include <sensor_hub/acquisition.h>
#include <sensor_hub/sensor_hub.h>
#include <sensor_hub/sim_bus.h>

LOG_MODULE_REGISTER(sensor_hub, LOG_LEVEL_INF);

#define SAMPLE_QUEUE_CAPACITY 8
#define THREAD_STACK_SIZE 1024

K_MSGQ_DEFINE(sample_queue, sizeof(struct sensor_hub_sample),
	      SAMPLE_QUEUE_CAPACITY, 4);
K_SEM_DEFINE(start_sem, 0, 5);

static struct sensor_hub_state hub_state;
static struct sensor_hub_sim_bus temp_bus;
static struct sensor_hub_sim_bus vibration_bus;
static struct sensor_hub_driver temp_driver;
static struct sensor_hub_driver vibration_driver;

static const struct sensor_hub_bus_ops sim_bus_ops = {
	.read = sensor_hub_sim_bus_read,
};

static int32_t deterministic_value(enum sensor_hub_sensor_id id, uint32_t sequence)
{
	if (id == SENSOR_HUB_TEMP) {
		return 22000 + (int32_t)((sequence % 10U) * 25U);
	}

	return 1000 + (int32_t)((sequence % 5U) * 100U);
}

static void producer_thread(void *p1, void *p2, void *p3)
{
	ARG_UNUSED(p2);
	ARG_UNUSED(p3);

	const enum sensor_hub_sensor_id id =
		(enum sensor_hub_sensor_id)(uintptr_t)p1;
	const k_timeout_t period =
		id == SENSOR_HUB_TEMP ? K_MSEC(50) : K_MSEC(80);
	struct sensor_hub_sim_bus *bus =
		id == SENSOR_HUB_TEMP ? &temp_bus : &vibration_bus;
	struct sensor_hub_driver *driver =
		id == SENSOR_HUB_TEMP ? &temp_driver : &vibration_driver;
	uint32_t sequence = 0U;
	bool bus_fault_injected = false;

	k_sem_take(&start_sem, K_FOREVER);

	while (true) {
		if (id == SENSOR_HUB_VIBRATION &&
		    IS_ENABLED(CONFIG_SENSOR_HUB_INJECT_STALL) &&
		    sequence >= CONFIG_SENSOR_HUB_STALL_AFTER_SAMPLES) {
			LOG_WRN("fault injection: vibration producer stalled at seq=%u",
				sequence);
			while (true) {
				k_sleep(K_SECONDS(1));
			}
		}

		if (id == SENSOR_HUB_VIBRATION &&
		    IS_ENABLED(CONFIG_SENSOR_HUB_INJECT_BUS_FAULT) &&
		    !bus_fault_injected &&
		    sequence >= CONFIG_SENSOR_HUB_BUS_FAULT_AFTER_SAMPLES) {
			sensor_hub_sim_bus_inject_failures(
				bus, CONFIG_SENSOR_HUB_BUS_FAULT_ATTEMPTS);
			bus_fault_injected = true;
			LOG_WRN("fault injection: vibration bus failures=%d at seq=%u",
				CONFIG_SENSOR_HUB_BUS_FAULT_ATTEMPTS, sequence);
		}

		sensor_hub_sim_bus_set_value(bus, id,
					 deterministic_value(id, sequence));

		struct sensor_hub_sample sample;
		const int rc = sensor_hub_driver_read(
			driver, id, sequence, k_uptime_get_32(), &sample);

		if (rc != 0) {
			LOG_WRN("acquisition failed: sensor=%u seq=%u rc=%d",
				(unsigned int)id, sequence, rc);
			k_sleep(period);
			continue;
		}

		if (k_msgq_put(&sample_queue, &sample, K_NO_WAIT) == 0) {
			sensor_hub_record_enqueue(
				&hub_state, k_msgq_num_used_get(&sample_queue));
		} else {
			sensor_hub_record_drop(&hub_state);
		}

		sequence++;
		k_sleep(period);
	}
}

static void consumer_thread(void *p1, void *p2, void *p3)
{
	ARG_UNUSED(p1);
	ARG_UNUSED(p2);
	ARG_UNUSED(p3);

	struct sensor_hub_sample sample;

	k_sem_take(&start_sem, K_FOREVER);

	while (true) {
		k_msgq_get(&sample_queue, &sample, K_FOREVER);
		(void)sensor_hub_consume(&hub_state, &sample);
	}
}

static void supervisor_thread(void *p1, void *p2, void *p3)
{
	ARG_UNUSED(p1);
	ARG_UNUSED(p2);
	ARG_UNUSED(p3);

	bool previous_stale[SENSOR_HUB_SENSOR_COUNT] = {false};

	k_sem_take(&start_sem, K_FOREVER);

	while (true) {
		struct sensor_hub_metrics metrics;

		sensor_hub_supervise(&hub_state, k_uptime_get_32(),
				     CONFIG_SENSOR_HUB_STALE_AFTER_MS);
		sensor_hub_snapshot(&hub_state, &metrics);

		for (size_t i = 0; i < SENSOR_HUB_SENSOR_COUNT; ++i) {
			if (metrics.stale[i] && !previous_stale[i]) {
				LOG_WRN("software watchdog: sensor=%u stale",
					(unsigned int)i);
			}
			previous_stale[i] = metrics.stale[i];
		}

		k_sleep(K_MSEC(100));
	}
}

static void telemetry_thread(void *p1, void *p2, void *p3)
{
	ARG_UNUSED(p1);
	ARG_UNUSED(p2);
	ARG_UNUSED(p3);

	k_sem_take(&start_sem, K_FOREVER);

	while (true) {
		struct sensor_hub_metrics metrics;
		struct sensor_hub_driver_stats temp_stats;
		struct sensor_hub_driver_stats vibration_stats;

		sensor_hub_snapshot(&hub_state, &metrics);
		sensor_hub_driver_snapshot(&temp_driver, &temp_stats);
		sensor_hub_driver_snapshot(&vibration_driver, &vibration_stats);

		LOG_INF("accepted=%u dropped=%u stale_events=%u q_high=%u temp=%d vib=%d",
			metrics.accepted_samples,
			metrics.dropped_samples,
			metrics.stale_events,
			metrics.queue_high_watermark,
			metrics.last_value_milli[SENSOR_HUB_TEMP],
			metrics.last_value_milli[SENSOR_HUB_VIBRATION]);
		LOG_INF("bus temp attempts=%u retries=%u fail=%u vib attempts=%u retries=%u fail=%u",
			temp_stats.transfer_attempts,
			temp_stats.retry_attempts,
			temp_stats.failed_reads,
			vibration_stats.transfer_attempts,
			vibration_stats.retry_attempts,
			vibration_stats.failed_reads);
		k_sleep(K_MSEC(500));
	}
}

K_THREAD_DEFINE(temp_producer, THREAD_STACK_SIZE, producer_thread,
		(void *)(uintptr_t)SENSOR_HUB_TEMP, NULL, NULL,
		4, 0, 0);
K_THREAD_DEFINE(vibration_producer, THREAD_STACK_SIZE, producer_thread,
		(void *)(uintptr_t)SENSOR_HUB_VIBRATION, NULL, NULL,
		4, 0, 0);
K_THREAD_DEFINE(consumer, THREAD_STACK_SIZE, consumer_thread,
		NULL, NULL, NULL, 3, 0, 0);
K_THREAD_DEFINE(supervisor, THREAD_STACK_SIZE, supervisor_thread,
		NULL, NULL, NULL, 2, 0, 0);
K_THREAD_DEFINE(telemetry, THREAD_STACK_SIZE, telemetry_thread,
		NULL, NULL, NULL, 5, 0, 0);

int main(void)
{
	sensor_hub_init(&hub_state);
	sensor_hub_sim_bus_init(&temp_bus);
	sensor_hub_sim_bus_init(&vibration_bus);

	int rc = sensor_hub_driver_init(
		&temp_driver, &sim_bus_ops, &temp_bus,
		CONFIG_SENSOR_HUB_DRIVER_MAX_RETRIES);
	if (rc != 0) {
		LOG_ERR("temperature driver init failed: rc=%d", rc);
		return rc;
	}

	rc = sensor_hub_driver_init(
		&vibration_driver, &sim_bus_ops, &vibration_bus,
		CONFIG_SENSOR_HUB_DRIVER_MAX_RETRIES);
	if (rc != 0) {
		LOG_ERR("vibration driver init failed: rc=%d", rc);
		return rc;
	}

	for (int i = 0; i < 5; ++i) {
		k_sem_give(&start_sem);
	}

	LOG_INF("sensor hub started: queue=%u stale_timeout_ms=%d stall_injection=%d bus_fault=%d",
		SAMPLE_QUEUE_CAPACITY,
		CONFIG_SENSOR_HUB_STALE_AFTER_MS,
		IS_ENABLED(CONFIG_SENSOR_HUB_INJECT_STALL),
		IS_ENABLED(CONFIG_SENSOR_HUB_INJECT_BUS_FAULT));

	return 0;
}
```

## src/acquisition.c
```c
/*
 * Copyright (c) 2026 Taha Zarif
 *
 * SPDX-License-Identifier: Apache-2.0
 */

#include <errno.h>
#include <string.h>

#include <sensor_hub/acquisition.h>

#define SENSOR_HUB_VALUE_BYTES 4U

static int request_for_sensor(enum sensor_hub_sensor_id sensor,
			      struct sensor_hub_bus_request *request)
{
	switch (sensor) {
	case SENSOR_HUB_TEMP:
		*request = (struct sensor_hub_bus_request) {
			.bus = SENSOR_HUB_BUS_I2C,
			.device = 0x48U,
			.reg = 0x00U,
		};
		return 0;
	case SENSOR_HUB_VIBRATION:
		*request = (struct sensor_hub_bus_request) {
			.bus = SENSOR_HUB_BUS_SPI,
			.device = 0x01U,
			.reg = 0x10U,
		};
		return 0;
	default:
		return -EINVAL;
	}
}

static int32_t decode_le32(const uint8_t data[SENSOR_HUB_VALUE_BYTES])
{
	const uint32_t value =
		((uint32_t)data[0]) |
		((uint32_t)data[1] << 8) |
		((uint32_t)data[2] << 16) |
		((uint32_t)data[3] << 24);

	return (int32_t)value;
}

int sensor_hub_driver_init(struct sensor_hub_driver *driver,
			   const struct sensor_hub_bus_ops *ops,
			   void *context,
			   uint8_t max_retries)
{
	if (driver == NULL || ops == NULL || ops->read == NULL) {
		return -EINVAL;
	}

	memset(driver, 0, sizeof(*driver));
	k_mutex_init(&driver->lock);
	driver->ops = *ops;
	driver->context = context;
	driver->max_retries = max_retries;

	return 0;
}

int sensor_hub_driver_read(struct sensor_hub_driver *driver,
			   enum sensor_hub_sensor_id sensor,
			   uint32_t sequence,
			   uint32_t timestamp_ms,
			   struct sensor_hub_sample *sample)
{
	struct sensor_hub_bus_request request;
	uint8_t data[SENSOR_HUB_VALUE_BYTES];
	int rc;

	if (driver == NULL || sample == NULL ||
	    sensor >= SENSOR_HUB_SENSOR_COUNT) {
		return -EINVAL;
	}

	rc = request_for_sensor(sensor, &request);
	if (rc != 0) {
		return rc;
	}

	k_mutex_lock(&driver->lock, K_FOREVER);

	for (uint32_t attempt = 0U; attempt <= driver->max_retries; ++attempt) {
		driver->stats.transfer_attempts++;
		if (attempt > 0U) {
			driver->stats.retry_attempts++;
		}

		rc = driver->ops.read(driver->context, &request,
				      data, sizeof(data));
		if (rc == 0) {
			break;
		}
	}

	if (rc != 0) {
		driver->stats.failed_reads++;
		k_mutex_unlock(&driver->lock);
		return rc;
	}

	bool sequence_error = false;
	bool timestamp_error = false;

	if (driver->seen[sensor]) {
		const uint32_t expected = driver->last_sequence[sensor] + 1U;

		if (sequence != expected) {
			driver->stats.sequence_errors++;
			sequence_error = true;
		}

		if (timestamp_ms < driver->last_timestamp_ms[sensor]) {
			driver->stats.timestamp_regressions++;
			timestamp_error = true;
		}
	}

	/* Resynchronize sequence tracking after an anomaly so one bad sample does
	 * not create an unbounded cascade of sequence errors.
	 */
	driver->last_sequence[sensor] = sequence;
	if (!driver->seen[sensor] || !timestamp_error) {
		driver->last_timestamp_ms[sensor] = timestamp_ms;
	}
	driver->seen[sensor] = true;

	if (sequence_error) {
		k_mutex_unlock(&driver->lock);
		return -EILSEQ;
	}

	if (timestamp_error) {
		k_mutex_unlock(&driver->lock);
		return -ERANGE;
	}

	*sample = (struct sensor_hub_sample) {
		.sequence = sequence,
		.timestamp_ms = timestamp_ms,
		.value_milli = decode_le32(data),
		.sensor_id = (uint8_t)sensor,
	};

	k_mutex_unlock(&driver->lock);
	return 0;
}

void sensor_hub_driver_snapshot(struct sensor_hub_driver *driver,
				struct sensor_hub_driver_stats *snapshot)
{
	if (driver == NULL || snapshot == NULL) {
		return;
	}

	k_mutex_lock(&driver->lock, K_FOREVER);
	*snapshot = driver->stats;
	k_mutex_unlock(&driver->lock);
}
```

## src/sensor_hub.c
```c
/*
 * Copyright (c) 2026 Taha Zarif
 *
 * SPDX-License-Identifier: Apache-2.0
 */

#include <errno.h>
#include <string.h>

#include <sensor_hub/sensor_hub.h>

void sensor_hub_init(struct sensor_hub_state *state)
{
	memset(state, 0, sizeof(*state));
	k_mutex_init(&state->lock);
}

void sensor_hub_record_enqueue(struct sensor_hub_state *state, uint32_t queue_depth)
{
	k_mutex_lock(&state->lock, K_FOREVER);
	if (queue_depth > state->metrics.queue_high_watermark) {
		state->metrics.queue_high_watermark = queue_depth;
	}
	k_mutex_unlock(&state->lock);
}

void sensor_hub_record_drop(struct sensor_hub_state *state)
{
	k_mutex_lock(&state->lock, K_FOREVER);
	state->metrics.dropped_samples++;
	k_mutex_unlock(&state->lock);
}

int sensor_hub_consume(struct sensor_hub_state *state,
		       const struct sensor_hub_sample *sample)
{
	if (sample == NULL || sample->sensor_id >= SENSOR_HUB_SENSOR_COUNT) {
		return -EINVAL;
	}

	k_mutex_lock(&state->lock, K_FOREVER);
	state->metrics.accepted_samples++;
	state->metrics.last_sequence[sample->sensor_id] = sample->sequence;
	state->metrics.last_seen_ms[sample->sensor_id] = sample->timestamp_ms;
	state->metrics.last_value_milli[sample->sensor_id] = sample->value_milli;
	state->metrics.seen[sample->sensor_id] = true;
	state->metrics.stale[sample->sensor_id] = false;
	k_mutex_unlock(&state->lock);

	return 0;
}

void sensor_hub_supervise(struct sensor_hub_state *state,
			  uint32_t now_ms,
			  uint32_t stale_after_ms)
{
	k_mutex_lock(&state->lock, K_FOREVER);

	for (size_t i = 0; i < SENSOR_HUB_SENSOR_COUNT; ++i) {
		if (!state->metrics.seen[i]) {
			continue;
		}

		const uint32_t age_ms = now_ms - state->metrics.last_seen_ms[i];
		const bool is_stale = age_ms > stale_after_ms;

		if (is_stale && !state->metrics.stale[i]) {
			state->metrics.stale_events++;
		}
		state->metrics.stale[i] = is_stale;
	}

	k_mutex_unlock(&state->lock);
}

void sensor_hub_snapshot(struct sensor_hub_state *state,
			 struct sensor_hub_metrics *snapshot)
{
	k_mutex_lock(&state->lock, K_FOREVER);
	*snapshot = state->metrics;
	k_mutex_unlock(&state->lock);
}
```

## src/sim_bus.c
```c
/*
 * Copyright (c) 2026 Taha Zarif
 *
 * SPDX-License-Identifier: Apache-2.0
 */

#include <errno.h>
#include <string.h>

#include <sensor_hub/sim_bus.h>

void sensor_hub_sim_bus_init(struct sensor_hub_sim_bus *bus)
{
	memset(bus, 0, sizeof(*bus));
}

void sensor_hub_sim_bus_set_value(struct sensor_hub_sim_bus *bus,
				  enum sensor_hub_sensor_id sensor,
				  int32_t value_milli)
{
	if (bus == NULL || sensor >= SENSOR_HUB_SENSOR_COUNT) {
		return;
	}

	bus->value_milli[sensor] = value_milli;
}

void sensor_hub_sim_bus_inject_failures(struct sensor_hub_sim_bus *bus,
					uint32_t failures)
{
	if (bus != NULL) {
		bus->failures_remaining = failures;
	}
}

static int sensor_from_request(const struct sensor_hub_bus_request *request)
{
	if (request->bus == SENSOR_HUB_BUS_I2C &&
	    request->device == 0x48U && request->reg == 0x00U) {
		return SENSOR_HUB_TEMP;
	}

	if (request->bus == SENSOR_HUB_BUS_SPI &&
	    request->device == 0x01U && request->reg == 0x10U) {
		return SENSOR_HUB_VIBRATION;
	}

	return -ENODEV;
}

int sensor_hub_sim_bus_read(void *context,
			    const struct sensor_hub_bus_request *request,
			    uint8_t *data,
			    size_t len)
{
	struct sensor_hub_sim_bus *bus = context;

	if (bus == NULL || request == NULL || data == NULL || len != 4U) {
		return -EINVAL;
	}

	bus->transfer_calls++;
	bus->last_request = *request;

	if (bus->failures_remaining > 0U) {
		bus->failures_remaining--;
		return -EIO;
	}

	const int sensor = sensor_from_request(request);
	if (sensor < 0) {
		return sensor;
	}

	const uint32_t value = (uint32_t)bus->value_milli[sensor];
	data[0] = (uint8_t)(value & 0xffU);
	data[1] = (uint8_t)((value >> 8) & 0xffU);
	data[2] = (uint8_t)((value >> 16) & 0xffU);
	data[3] = (uint8_t)((value >> 24) & 0xffU);

	return 0;
}
```
